&pmu_io_domains {
    status = "okay";
    pmuio0-supply = <&vcc3v3_sys>;
    pmuio1-supply = <&vcc3v3_sys>;
    vccio1-supply = <&vcc_1v8>;
    vccio2-supply = <&vccio_sd>;
    vccio3-supply = <&vcc_3v3>;
    vccio4-supply = <&vcc_3v3>;
    vccio5-supply = <&vcc_3v3>;
    vccio6-supply = <&vcc_3v3>;
    vccio7-supply = <&vcc_1v8>;
};