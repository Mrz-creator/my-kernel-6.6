
&uart4 {
    wakeup-source;
    dma-names = "!tx", "!rx";
    pinctrl-names = "default";
    pinctrl-0 = <&uart4m2_xfer>;
    clock-frequency = <1843200>;
    rockchip,baudrate = <115200>;
    status = "okay";
};