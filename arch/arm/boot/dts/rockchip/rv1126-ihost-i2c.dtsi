&i2c2 {
    status = "okay";
    clock-frequency = <100000>;

    pcf8563: pcf8563@51 {
        compatible = "nxp,pcf8563";
        reg = <0x51>;
        #clock-cells = <0>;
        interrupt-parent = <&gpio0>;
        interrupts = <7 8>;
        clock-output-names = "xin32k";
    };
};

&i2c5 {
    status = "disabled";
};