// SPDX-License-Identifier: (GPL-2.0+ OR MIT)
/*
 * Copyright (c) 2020 Rockchip Electronics Co., Ltd.
 */

#include "rv1126-evb-v12.dtsi"

&pwm0 {
	status = "okay";
};

&pwm3 {
	status = "disabled";
};

&u2phy0 {
	vup-gpios = <&gpio0 RK_PC1 GPIO_ACTIVE_LOW>;
};
